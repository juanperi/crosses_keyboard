&trackball_peripheral {
    cpi = <200>;
};

&trackball_peripheral_split {
    input-processors
        = <&zip_xy_to_scroll_mapper>
        , <&zip_left_scroll_invert (-1) 1>
        , <&zip_left_scroll_detent>
        , <&zip_ble_report_rate_limit>
        ;
};
