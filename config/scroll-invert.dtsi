#include <zephyr/dt-bindings/input/input-event-codes.h>

/ {
    zip_left_scroll_invert: zip_left_scroll_invert {
        compatible = "zmk,input-processor-scaler";
        #input-processor-cells = <2>;
        type = <INPUT_EV_REL>;
        codes = <INPUT_REL_WHEEL>;
        track-remainders;
    };

    zip_left_scroll_detent: zip_left_scroll_detent {
        compatible = "zmk,input-processor-scroll-detent";
        #input-processor-cells = <0>;
        type = <INPUT_EV_REL>;
        codes = <INPUT_REL_WHEEL INPUT_REL_HWHEEL>;
        threshold = <5760>;
    };
};
